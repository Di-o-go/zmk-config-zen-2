## config/west.yml
```yaml
manifest:
  remotes:
    - name: zmkfirmware
      url-base: https://github.com/LOWPROKB
    - name: stites
      url-base: https://github.com/stites
  projects:
    - name: zmk
      remote: sites
      revision: corne-ish-zen-v2+plover
      import: app/west.yml
  self:
    path: config
```
